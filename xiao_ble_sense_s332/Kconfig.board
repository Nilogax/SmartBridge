## xiao_ble_sense_s332/Kconfig.board
```kconfig
# XIAO BLE Sense S332 board configuration (ANT+ + BLE)
# SPDX-License-Identifier: Apache-2.0
config BOARD_XIAO_BLE_SENSE_S332
        bool "XIAO BLE Sense S332"
        depends on SOC_NRF52840_QIAA
```

## xiao_ble_sense_s332/Kconfig.defconfig
```kconfig
# XIAO BLE Sense S332 board configuration
# SPDX-License-Identifier: Apache-2.0
if BOARD_XIAO_BLE_SENSE_S332

config BOARD
        default "xiao_ble_sense_s332"

config BT_CTLR
        default BT

endif # BOARD_XIAO_BLE_SENSE_S332

if USB_DEVICE_STACK
config UART_CONSOLE
        default CONSOLE
config USB_DEVICE_INITIALIZE_AT_BOOT
        default y
endif # USB_DEVICE_STACK
```
